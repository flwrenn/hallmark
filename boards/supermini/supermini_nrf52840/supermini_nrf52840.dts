/*
 * SuperMini nRF52840 -- base variant (no bootloader, standard partitions).
 * Use this with a J-Link debug probe.
 */

#include "supermini_nrf52840_common.dtsi"
#include <nordic/nrf52840_partition.dtsi>

/ {
	model = "SuperMini nRF52840";
	compatible = "supermini,nrf52840";

	chosen {
		zephyr,console = &uart0;
		zephyr,shell-uart = &uart0;
	};
};
