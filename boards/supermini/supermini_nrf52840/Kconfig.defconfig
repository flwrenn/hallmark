## boards/supermini/supermini_nrf52840/board.yml
```yaml
board:
  name: supermini_nrf52840
  full_name: SuperMini nRF52840
  vendor: generic
  socs:
    - name: nrf52840
      variants:
        - name: uf2
```

## boards/supermini/supermini_nrf52840/supermini_nrf52840_nrf52840_uf2_defconfig
```kconfig
CONFIG_ARM_MPU=y
CONFIG_GPIO=y
CONFIG_SERIAL=y
CONFIG_CONSOLE=y
CONFIG_UART_CONSOLE=y

# UF2 bootloader support
CONFIG_USE_DT_CODE_PARTITION=y
CONFIG_BUILD_OUTPUT_UF2=y

# Flash access for settings/NVS
CONFIG_MPU_ALLOW_FLASH_WRITE=y
CONFIG_FLASH=y
CONFIG_FLASH_PAGE_LAYOUT=y
CONFIG_FLASH_MAP=y

# Pin control
CONFIG_PINCTRL=y
```
