## CMakeLists.txt
```
cmake_minimum_required(VERSION 3.20.0)
find_package(Zephyr REQUIRED HINTS $ENV{ZEPHYR_BASE})
project(hallmark)

target_include_directories(app PRIVATE include)

target_sources(app PRIVATE
  src/main.c
  src/rapid_trigger.c
  src/home_row_mod.c
  src/socd.c
  src/keymap_config.c
)
```

## prj.conf
```kconfig
# Language standard (matches tests/CMakeLists.txt CMAKE_C_STANDARD 11)
CONFIG_STD_C11=y

# Logging
CONFIG_LOG=y
```

## src/main.c
```c
/*
 * Minimal blink + USB serial — validates toolchain, board definition,
 * GPIO, and USB CDC ACM console on SuperMini nRF52840.
 */

#include <zephyr/kernel.h>
#include <zephyr/drivers/gpio.h>
#include <zephyr/logging/log.h>

LOG_MODULE_REGISTER(hallmark, LOG_LEVEL_INF);

#define BLINK_INTERVAL_MS 500

static const struct gpio_dt_spec led = GPIO_DT_SPEC_GET(DT_ALIAS(led0), gpios);

int main(void)
{
    int ret;
    unsigned int count = 0;

    /* Wait for USB host to enumerate CDC ACM device before logging */
    k_msleep(1000);

    if (!gpio_is_ready_dt(&led)) {
        LOG_ERR("LED device not ready");
        return -ENODEV;
    }

    ret = gpio_pin_configure_dt(&led, GPIO_OUTPUT_INACTIVE);
    if (ret < 0) {
        LOG_ERR("Failed to configure LED: %d", ret);
        return ret;
    }

    LOG_INF("Hallmark firmware v0.0.1");
    LOG_INF("Board: SuperMini nRF52840");
    LOG_INF("LED blink started (%d ms interval)", BLINK_INTERVAL_MS);

    while (1) {
        gpio_pin_toggle_dt(&led);
        if (++count % 10 == 0) {
            LOG_INF("Heartbeat: %u toggles", count);
        }
        k_msleep(BLINK_INTERVAL_MS);
    }

    return 0;
}
```

## include/home_row_mod.h
```c
/*
 * Depth-based Home Row Mods -- tap/hold decision using key travel
 * depth combined with a time fallback.
 *
 * Pure C module, no RTOS dependencies.
 *
 * Resolution paths:
 *   1. Released before depth AND time thresholds  ->  TAP  (letter)
 *   2. Crosses depth threshold at any time        ->  HOLD (modifier, immediate)
 *   3. Held past time threshold without depth     ->  HOLD (fallback)
 */

#ifndef HOME_ROW_MOD_H
#define HOME_ROW_MOD_H

#include <stdbool.h>
#include <stdint.h>

/* ---------------------------------------------------------------------
 * Types
 * ------------------------------------------------------------------ */

enum hrm_action {
    HRM_PENDING, /* decision not yet made */
    HRM_TAP,     /* resolved as tap (letter) */
    HRM_HOLD,    /* resolved as hold (modifier) */
};

/**
 * Per-key configuration.  Supports per-finger tuning -- pinkies may
 * need a deeper depth threshold or longer time window than index fingers.
 *
 * @depth_threshold_adc  ADC value that triggers an immediate HOLD.
 *                       Relative to rest (rest_adc + depth_threshold_adc
 *                       gives the absolute trigger point).
 * @time_threshold_ms    Milliseconds after which a sustained press
 *                       without depth resolves as HOLD (fallback).
 * @rest_adc             ADC reading at rest (key fully released).
 */
struct hrm_config {
    uint16_t depth_threshold_adc;
    uint32_t time_threshold_ms;
    uint16_t rest_adc;
};

/**
 * Per-key runtime state.  Call hrm_init() once at startup to
 * zero-initialise; hrm_press() resets the decision state on each
 * key-down.
 */
struct hrm_key_state {
    enum hrm_action action;
    uint32_t press_start_ms;
    uint16_t max_depth_adc; /* peak depth relative to rest */
    bool pressed;           /* whether the key is currently down */
};

/* ---------------------------------------------------------------------
 * API
 * ------------------------------------------------------------------ */

/**
 * Initialise a key state.  Call once at startup.
 */
void hrm_init(struct hrm_key_state *key);

/**
 * Signal that the key has been pressed.  Resets the HRM decision state.
 *
 * @timestamp_ms  Current time in milliseconds.
 */
void hrm_press(struct hrm_key_state *key, uint32_t timestamp_ms);

/**
 * Feed a new ADC sample while the key is held.
 *
 * @adc           Current ADC reading for this key.
 * @timestamp_ms  Current time in milliseconds.
 * @cfg           Per-key HRM configuration.
 *
 * Returns the current action (PENDING, TAP, or HOLD).  Once resolved
 * to TAP or HOLD the result is latched until the next hrm_press().
 */
enum hrm_action hrm_update(struct hrm_key_state *key, uint16_t adc, uint32_t timestamp_ms,
                           const struct hrm_config *cfg);

/**
 * Signal that the key has been released.
 *
 * If the action is still PENDING at release, it resolves as TAP.
 *
 * Returns the final resolved action.
 */
enum hrm_action hrm_release(struct hrm_key_state *key);

#endif /* HOME_ROW_MOD_H */
```

## include/keymap_config.h
```c
/*
 * Keymap configuration for Hallmark.
 *
 * 36-key Chocofi split keyboard. Colemak-DH base, SCAG home row mods,
 * 9 layers, 22 combos, 2 SOCD pairs.
 *
 * NOTE: Keycode values are placeholders. The Keymap firmware module
 * (not yet implemented) will define the actual encoding. Layer arrays
 * and config structs are structurally correct and ready to be wired
 * into the module.
 */

#ifndef KEYMAP_CONFIG_H
#define KEYMAP_CONFIG_H

#include <stdint.h>

/* -------------------------------------------------------------------
 * Layers
 * ---------------------------------------------------------------- */

enum keymap_layer {
    L_BASE,
    L_SYM,
    L_NAV,
    L_NUM,
    L_GAME,
    L_GAMENUM,
    L_GAMEALT,
    L_NOMOD,
    L_ORIGIN,
    KEYMAP_LAYERS,
};

/* -------------------------------------------------------------------
 * Key positions
 *
 * Index into layer arrays.  Enumerator order is the layer array
 * order: one row at a time, left half then right half, thumbs last.
 *
 *  L01  L02  L03  L04  L05    R01  R02  R03  R04  R05
 *  L06  L07  L08  L09  L10    R06  R07  R08  R09  R10
 *  L11  L12  L13  L14  L15    R11  R12  R13  R14  R15
 *            LT1  LT2  LT3    RT1  RT2  RT3
 *
 * POS_NONE terminates position lists.
 * ---------------------------------------------------------------- */

enum keymap_pos {
    POS_L01,
    POS_L02,
    POS_L03,
    POS_L04,
    POS_L05,
    POS_R01,
    POS_R02,
    POS_R03,
    POS_R04,
    POS_R05,

    POS_L06,
    POS_L07,
    POS_L08,
    POS_L09,
    POS_L10,
    POS_R06,
    POS_R07,
    POS_R08,
    POS_R09,
    POS_R10,

    POS_L11,
    POS_L12,
    POS_L13,
    POS_L14,
    POS_L15,
    POS_R11,
    POS_R12,
    POS_R13,
    POS_R14,
    POS_R15,

    POS_LT1,
    POS_LT2,
    POS_LT3,
    POS_RT1,
    POS_RT2,
    POS_RT3,

    KEYMAP_KEYS,
    POS_NONE = KEYMAP_KEYS,
};

/* -------------------------------------------------------------------
 * Keycodes  (placeholders -- Keymap module will define encoding)
 * ---------------------------------------------------------------- */

/* Special */
#define KC_TRNS 0x0000 /* Transparent: falls through to layer below */

/* Alphas (USB HID usage page 0x07) */
#define KC_A 0x04
#define KC_B 0x05
#define KC_C 0x06
#define KC_D 0x07
#define KC_E 0x08
#define KC_F 0x09
#define KC_G 0x0A
#define KC_H 0x0B
#define KC_I 0x0C
#define KC_J 0x0D
#define KC_K 0x0E
#define KC_L 0x0F
#define KC_M 0x10
#define KC_N 0x11
#define KC_O 0x12
#define KC_P 0x13
#define KC_Q 0x14
#define KC_R 0x15
#define KC_S 0x16
#define KC_T 0x17
#define KC_U 0x18
#define KC_V 0x19
#define KC_W 0x1A
#define KC_X 0x1B
#define KC_Y 0x1C
#define KC_Z 0x1D

/* Numbers */
#define KC_1 0x1E
#define KC_2 0x1F
#define KC_3 0x20
#define KC_4 0x21
#define KC_5 0x22
#define KC_6 0x23
#define KC_7 0x24
#define KC_8 0x25
#define KC_9 0x26
#define KC_0 0x27

/* Punctuation */
#define KC_QUOT 0x34 /* '  */
#define KC_GRV  0x35 /* `  */
#define KC_COMM 0x36 /* ,  */
#define KC_DOT  0x37 /* .  */
#define KC_SCLN 0x33 /* ;  */
#define KC_SLSH 0x38 /* /  */
#define KC_BSLS 0x31 /* \  */
#define KC_MINS 0x2D /* -  */
#define KC_EQL  0x2E /* =  */
#define KC_LBRC 0x2F /* [  */
#define KC_RBRC 0x30 /* ]  */

/* Editing */
#define KC_ESC  0x29
#define KC_TAB  0x2B
#define KC_SPC  0x2C
#define KC_ENT  0x28
#define KC_BSPC 0x2A
#define KC_DEL  0x4C
#define KC_INS  0x49
#define KC_CAPS 0x39

/* Navigation */
#define KC_LEFT 0x50
#define KC_DOWN 0x51
#define KC_UP   0x52
#define KC_RGHT 0x4F
#define KC_HOME 0x4A
#define KC_END  0x4D
#define KC_PGUP 0x4B
#define KC_PGDN 0x4E

/* Function keys */
#define KC_F1  0x3A
#define KC_F2  0x3B
#define KC_F3  0x3C
#define KC_F4  0x3D
#define KC_F5  0x3E
#define KC_F6  0x3F
#define KC_F7  0x40
#define KC_F8  0x41
#define KC_F9  0x42
#define KC_F10 0x43
#define KC_F11 0x44
#define KC_F12 0x45

/* Modifiers */
#define KC_LSFT 0xE1
#define KC_LCTL 0xE0
#define KC_LALT 0xE2
#define KC_LGUI 0xE3
#define KC_RSFT 0xE5
#define KC_RCTL 0xE4
#define KC_RALT 0xE6
#define KC_RGUI 0xE7

/*
 * Actions
 *
 * Provisional 16-bit encoding.  The high nibble names the kind, so
 * KM_KIND() recovers it from any alias.  KM_UC uses the top bit alone
 * to leave 15 bits for the codepoint.  The Keymap module owns the
 * final encoding.
 *
 *   0x00xx   basic keycode (HID usage page 0x07)
 *   0x01xx   KM_S(kc)          Shifted keycode
 *   0x1xxx   KM_MO(layer)      Momentary layer hold
 *   0x2xxx   KM_TG(layer)      Toggle layer on/off
 *   0x3lxx   KM_TH(tap, l)     Tap for key, hold for layer l (l < 16)
 *   0x4xxx   KM_OS(mod)        One-shot modifier
 *   0x5mxx   KM_HRM(tap, mod)  Tap for key, hold for modifier (m = mod & 7)
 *   0x7xxx   KM_MACRO(id)      Predefined macro
 *   0x8000+  KM_UC(cp)         Unicode codepoint (cp < 0x8000)
 */
#define KM_KIND_MO    0x1000
#define KM_KIND_TG    0x2000
#define KM_KIND_TH    0x3000
#define KM_KIND_OS    0x4000
#define KM_KIND_HRM   0x5000
#define KM_KIND_MACRO 0x7000
#define KM_KIND_UC    0x8000

#define KM_KIND(kc) (((kc) & KM_KIND_UC) ? KM_KIND_UC : ((kc) & 0xF000))

#define KM_S(kc)     (0x0100 | (kc))
#define KM_MO(l)     (KM_KIND_MO | (l))
#define KM_TG(l)     (KM_KIND_TG | (l))
#define KM_TH(t, l)  (KM_KIND_TH | ((l) << 8) | (t))
#define KM_OS(m)     (KM_KIND_OS | (m))
#define KM_HRM(t, m) (KM_KIND_HRM | (((m) & 0x7) << 8) | (t))
#define KM_MACRO(id) (KM_KIND_MACRO | (id))
#define KM_UC(cp)    (KM_KIND_UC | (cp))

/* Shifted key aliases */
#define KC_EXLM KM_S(KC_1)    /* ! */
#define KC_AT   KM_S(KC_2)    /* @ */
#define KC_HASH KM_S(KC_3)    /* # */
#define KC_DLR  KM_S(KC_4)    /* $ */
#define KC_PERC KM_S(KC_5)    /* % */
#define KC_CIRC KM_S(KC_6)    /* ^ */
#define KC_AMPR KM_S(KC_7)    /* & */
#define KC_ASTR KM_S(KC_8)    /* * */
#define KC_LPRN KM_S(KC_9)    /* ( */
#define KC_RPRN KM_S(KC_0)    /* ) */
#define KC_UNDS KM_S(KC_MINS) /* _ */
#define KC_PLUS KM_S(KC_EQL)  /* + */
#define KC_LCBR KM_S(KC_LBRC) /* { */
#define KC_RCBR KM_S(KC_RBRC) /* } */
#define KC_PIPE KM_S(KC_BSLS) /* | */
#define KC_TILD KM_S(KC_GRV)  /* ~ */
#define KC_QUES KM_S(KC_SLSH) /* ? */

/* Unicode aliases */
#define KC_EUR KM_UC(0x20AC) /* Euro sign */

/* Macro aliases */
#define MC_PTAB KM_MACRO(0)  /* Ctrl+Shift+Tab (previous tab) */
#define MC_NTAB KM_MACRO(1)  /* Ctrl+Tab (next tab)           */
#define MC_BACK KM_MACRO(2)  /* Browser back                  */
#define MC_FWD  KM_MACRO(3)  /* Browser forward               */
#define MC_PREV KM_MACRO(4)  /* Media previous track          */
#define MC_NEXT KM_MACRO(5)  /* Media next track              */
#define MC_PLAY KM_MACRO(6)  /* Media play/pause              */
#define MC_BRUP KM_MACRO(7)  /* Brightness up                 */
#define MC_BRDN KM_MACRO(8)  /* Brightness down               */
#define MC_VOLU KM_MACRO(9)  /* Volume up                     */
#define MC_VOLD KM_MACRO(10) /* Volume down                   */
#define MC_MUTE KM_MACRO(11) /* Mute                          */

/* One-shot modifier aliases */
#define OS_LSFT KM_OS(KC_LSFT)
#define OS_LCTL KM_OS(KC_LCTL)
#define OS_LALT KM_OS(KC_LALT)
#define OS_LGUI KM_OS(KC_LGUI)
#define OS_RSFT KM_OS(KC_RSFT)
#define OS_RCTL KM_OS(KC_RCTL)
#define OS_RALT KM_OS(KC_RALT)
#define OS_RGUI KM_OS(KC_RGUI)

/* One-shot hyper (Shift+Ctrl+Alt+GUI) */
#define OS_HYPR KM_MACRO(12)

/* Caps Word toggle (auto-deactivates after non-alpha; firmware TBD) */
#define CW_TOGG KM_MACRO(13)

/* Home row mod aliases */
#define HM_A KM_HRM(KC_A, KC_LSFT)
#define HM_R KM_HRM(KC_R, KC_LCTL)
#define HM_S KM_HRM(KC_S, KC_LALT)
#define HM_T KM_HRM(KC_T, KC_LGUI)
#define HM_N KM_HRM(KC_N, KC_RGUI)
#define HM_E KM_HRM(KC_E, KC_RALT)
#define HM_I KM_HRM(KC_I, KC_RCTL)
#define HM_O KM_HRM(KC_O, KC_RSFT)

/* Numeric layer HRM aliases */
#define HM_7 KM_HRM(KC_7, KC_LSFT)
#define HM_5 KM_HRM(KC_5, KC_LCTL)
#define HM_3 KM_HRM(KC_3, KC_LALT)
#define HM_1 KM_HRM(KC_1, KC_LGUI)
#define HM_0 KM_HRM(KC_0, KC_RGUI)
#define HM_2 KM_HRM(KC_2, KC_RALT)
#define HM_4 KM_HRM(KC_4, KC_RCTL)
#define HM_6 KM_HRM(KC_6, KC_RSFT)

/* Layer action aliases */
#define MO_NAV  KM_MO(L_NAV)
#define MO_SYM  KM_MO(L_SYM)
#define MO_NUM  KM_MO(L_NUM)
#define MO_GNUM KM_TH(KC_G, L_GAMENUM)

/* -------------------------------------------------------------------
 * Configuration tables  (defined in firmware/src/keymap_config.c)
 * ---------------------------------------------------------------- */

#define KEYMAP_HRM_COUNT      8
#define KEYMAP_HAND_KEYS      18
#define KEYMAP_COMBOS         22
#define KEYMAP_COMBO_MAX_KEYS 4
#define KEYMAP_SOCD_PAIRS     2

/*
 * Home row mod thresholds for one position.  Field names mirror
 * struct hrm_config (home_row_mod.h); the Keymap module copies them
 * into one at runtime and fills rest_adc from calibration.
 */
struct keymap_hrm {
    enum keymap_pos position;
    uint16_t depth_threshold_adc;
    uint32_t time_threshold_ms;
};

/*
 * Chord of up to KEYMAP_COMBO_MAX_KEYS positions, POS_NONE terminated.
 */
struct keymap_combo {
    enum keymap_pos positions[KEYMAP_COMBO_MAX_KEYS + 1];
    uint16_t output;
};

/*
 * Opposing key pair fed to one struct socd_pair (socd.h).
 */
struct keymap_socd_pair {
    enum keymap_pos pos_a;
    enum keymap_pos pos_b;
};

extern const uint16_t keymap_layers[KEYMAP_LAYERS][KEYMAP_KEYS];
extern const struct keymap_hrm keymap_hrm_table[];
extern const enum keymap_pos keymap_left_hand[];
extern const enum keymap_pos keymap_right_hand[];
extern const struct keymap_combo keymap_combos[];
extern const struct keymap_socd_pair keymap_socd_pairs[];

#endif /* KEYMAP_CONFIG_H */
```

## include/rapid_trigger.h
```c
/*
 * Rapid Trigger -- per-key actuation via direction reversal.
 *
 * Pure C module, no RTOS dependencies.  ADC values are expected to
 * increase as the key is pressed deeper (higher value = deeper press).
 *
 * State machine:
 *   IDLE  ──press past actuation──▸  ACTIVE
 *   ACTIVE ──reversal up past sensitivity──▸  RELEASING
 *   RELEASING ──reversal down past sensitivity──▸  ACTIVE
 *   ACTIVE / RELEASING ──passes release point──▸  IDLE
 */

#ifndef RAPID_TRIGGER_H
#define RAPID_TRIGGER_H

#include <stdint.h>

/* ---------------------------------------------------------------------
 * Types
 * ------------------------------------------------------------------ */

enum rt_state {
    RT_IDLE,
    RT_ACTIVE,
    RT_RELEASING,
};

enum rt_event {
    RT_EVENT_NONE,
    RT_EVENT_PRESS,
    RT_EVENT_RELEASE,
};

/**
 * Per-key configuration.  All values are in raw ADC counts.
 *
 * @rest_adc        ADC reading when the key is fully released (at rest).
 * @actuation_adc   ADC value that triggers the initial press from IDLE.
 * @release_adc     ADC value below which the key is considered fully
 *                  released, returning the FSM to IDLE.
 * @rt_sensitivity  Minimum change (in counts) from peak/trough required
 *                  to register a direction reversal.
 */
struct rt_config {
    uint16_t rest_adc;
    uint16_t actuation_adc;
    uint16_t release_adc;
    uint16_t rt_sensitivity;
};

/**
 * Per-key runtime state.  Initialise with rt_init() before first use.
 */
struct rt_key_state {
    enum rt_state state;
    uint16_t peak;   /* deepest ADC seen since last upward reversal  */
    uint16_t trough; /* shallowest ADC seen since last downward rev  */
    struct rt_config cfg;
};

/* ---------------------------------------------------------------------
 * API
 * ------------------------------------------------------------------ */

/**
 * Initialise (or reinitialise) a key's rapid-trigger state.
 */
void rt_init(struct rt_key_state *key, const struct rt_config *cfg);

/**
 * Feed a new ADC sample and return the resulting key event.
 *
 * Call once per scan cycle per key.  The function is pure -- it has no
 * side-effects beyond mutating *key and returns a deterministic result.
 */
enum rt_event rt_update(struct rt_key_state *key, uint16_t adc);

/* ---------------------------------------------------------------------
 * Helpers
 * ------------------------------------------------------------------ */

/**
 * Convert millimetres of travel to ADC counts.
 *
 * @counts_per_mm  Calibrated ratio (e.g. usable_range / travel_mm).
 */
static inline uint16_t rt_mm_to_counts(float mm, float counts_per_mm)
{
    return (uint16_t)(mm * counts_per_mm + 0.5f);
}

/**
 * Convert ADC counts to millimetres of travel.
 */
static inline float rt_counts_to_mm(uint16_t counts, float counts_per_mm)
{
    return (float)counts / counts_per_mm;
}

#endif /* RAPID_TRIGGER_H */
```

## include/socd.h
```c
/*
 * SOCD (Simultaneous Opposing Cardinal Directions) cleaning.
 *
 * Pure C module, no RTOS dependencies.
 *
 * Resolution strategy: last-input-wins.  When two opposing keys are
 * both active, the most recently pressed key takes priority.
 */

#ifndef SOCD_H
#define SOCD_H

#include <stdbool.h>

/* ---------------------------------------------------------------------
 * Types
 * ------------------------------------------------------------------ */

/**
 * Which key in an opposing pair was pressed most recently.
 */
enum socd_last {
    SOCD_LAST_NONE = 0,
    SOCD_LAST_A = 1,
    SOCD_LAST_B = 2,
};

/**
 * State for a single pair of opposing keys (e.g. left/right or up/down).
 *
 * @a_active     Whether key A is currently pressed.
 * @b_active     Whether key B is currently pressed.
 * @last_pressed Which key was pressed most recently.
 */
struct socd_pair {
    bool a_active;
    bool b_active;
    enum socd_last last_pressed;
};

/**
 * Resolved output for a pair.
 */
struct socd_result {
    bool a_output;
    bool b_output;
};

/* ---------------------------------------------------------------------
 * API
 * ------------------------------------------------------------------ */

/**
 * Initialise a pair to the neutral (neither pressed) state.
 */
void socd_init(struct socd_pair *pair);

/**
 * Update the pair state when key A is pressed.
 */
void socd_press_a(struct socd_pair *pair);

/**
 * Update the pair state when key A is released.
 */
void socd_release_a(struct socd_pair *pair);

/**
 * Update the pair state when key B is pressed.
 */
void socd_press_b(struct socd_pair *pair);

/**
 * Update the pair state when key B is released.
 */
void socd_release_b(struct socd_pair *pair);

/**
 * Resolve the current state using last-input-wins.
 *
 * If both keys are active, only the most recently pressed one outputs
 * true.  If only one key is active, it outputs true.  If neither is
 * active, both output false.
 */
struct socd_result socd_resolve(const struct socd_pair *pair);

#endif /* SOCD_H */
```

## src/home_row_mod.c
```c
/*
 * Depth-based Home Row Mod implementation.
 */

#include "home_row_mod.h"

/* --------------------------------------------------------------------- */

void hrm_init(struct hrm_key_state *key)
{
    key->action = HRM_PENDING;
    key->press_start_ms = 0;
    key->max_depth_adc = 0;
    key->pressed = false;
}

/* --------------------------------------------------------------------- */

void hrm_press(struct hrm_key_state *key, uint32_t timestamp_ms)
{
    key->action = HRM_PENDING;
    key->press_start_ms = timestamp_ms;
    key->max_depth_adc = 0;
    key->pressed = true;
}

/* --------------------------------------------------------------------- */

enum hrm_action hrm_update(struct hrm_key_state *key, uint16_t adc, uint32_t timestamp_ms,
                           const struct hrm_config *cfg)
{
    /* Already resolved -- return latched result. */
    if (key->action != HRM_PENDING) {
        return key->action;
    }

    /* Not pressed -- nothing to do. */
    if (!key->pressed) {
        return HRM_PENDING;
    }

    /* Track depth relative to rest. */
    uint16_t depth = (adc > cfg->rest_adc) ? (adc - cfg->rest_adc) : 0;
    if (depth > key->max_depth_adc) {
        key->max_depth_adc = depth;
    }

    /* Path 2: depth threshold crossed -> immediate HOLD. */
    if (key->max_depth_adc >= cfg->depth_threshold_adc) {
        key->action = HRM_HOLD;
        return HRM_HOLD;
    }

    /* Path 3: time threshold exceeded -> fallback HOLD. */
    uint32_t elapsed = timestamp_ms - key->press_start_ms;
    if (elapsed >= cfg->time_threshold_ms) {
        key->action = HRM_HOLD;
        return HRM_HOLD;
    }

    /* Still undecided. */
    return HRM_PENDING;
}

/* --------------------------------------------------------------------- */

enum hrm_action hrm_release(struct hrm_key_state *key)
{
    key->pressed = false;

    /* Path 1: still pending at release -> TAP. */
    if (key->action == HRM_PENDING) {
        key->action = HRM_TAP;
    }

    return key->action;
}
```

## src/keymap_config.c
```c
/*
 * Keymap configuration tables for Hallmark.
 *
 * Layer arrays, home row mod thresholds, hand sets, combos, and SOCD
 * pairs.  Types, keycodes, and dimensions live in keymap_config.h.
 */

#include "keymap_config.h"

#define KEYMAP_LEN(a) (sizeof(a) / sizeof((a)[0]))

/* -------------------------------------------------------------------
 * Layer arrays
 *
 * Each layer is a flat array of KEYMAP_KEYS entries in position order:
 *
 *   L01  L02  L03  L04  L05    R01  R02  R03  R04  R05
 *   L06  L07  L08  L09  L10    R06  R07  R08  R09  R10
 *   L11  L12  L13  L14  L15    R11  R12  R13  R14  R15
 *              LT1  LT2  LT3    RT1  RT2  RT3
 *
 * ___ in the per-layer diagrams is KC_TRNS.
 * ---------------------------------------------------------------- */

const uint16_t keymap_layers[KEYMAP_LAYERS][KEYMAP_KEYS] = {

        /* Layer 0: Base (Colemak-DH)
         *
         *   q     w     f     p     b          j     l     u     y     '
         *   a/S   r/C   s/A   t/G   g          m     n/G   e/A   i/C   o/S
         *   z     x     c     d     v          k     h     ,     .     ;
         *               Esc   NAV   Spc        Ent   SYM   Bks
         */
        [L_BASE] = {KC_Q,    KC_W,   KC_F,    KC_P,   KC_B,   KC_J,   KC_L,   KC_U,   KC_Y,
                    KC_QUOT, HM_A,   HM_R,    HM_S,   HM_T,   KC_G,   KC_M,   HM_N,   HM_E,
                    HM_I,    HM_O,   KC_Z,    KC_X,   KC_C,   KC_D,   KC_V,   KC_K,   KC_H,
                    KC_COMM, KC_DOT, KC_SCLN, KC_ESC, MO_NAV, KC_SPC, KC_ENT, MO_SYM, KC_BSPC},

        /* Layer 1: Symbols
         *
         *   Esc   [     {     (     ~          ^     )     }     ]     `
         *   -     *     =     _     $          EUR   Gos   Aos   Cos   Sos
         *   +     |     @     /     %          #     \     &     ?     !
         *               NUM   ___   ___        ___   ___   ___
         */
        [L_SYM] = {KC_ESC,  KC_LBRC, KC_LCBR, KC_LPRN, KC_TILD, KC_CIRC, KC_RPRN, KC_RCBR, KC_RBRC,
                   KC_GRV,  KC_MINS, KC_ASTR, KC_EQL,  KC_UNDS, KC_DLR,  KC_EUR,  OS_RGUI, OS_RALT,
                   OS_RCTL, OS_RSFT, KC_PLUS, KC_PIPE, KC_AT,   KC_SLSH, KC_PERC, KC_HASH, KC_BSLS,
                   KC_AMPR, KC_QUES, KC_EXLM, MO_NUM,  KC_TRNS, KC_TRNS, KC_TRNS, KC_TRNS, KC_TRNS},

        /* Layer 2: Navigation
         *
         *   Tab   PTb   NTb   Vo-   Vo+        Bck   Fwd   Hom   End   Del
         *   Sos   Cos   Aos   Gos   Mut        <     v     ^     >     Bks
         *   Br-   Br+   Prv   Nxt   Ply        Cap   PgD   PgU   Ins   Ent
         *               ___   ___   ___        NUM   ___   ___
         */
        [L_NAV] = {KC_TAB,  MC_PTAB, MC_NTAB, MC_VOLD, MC_VOLU, MC_BACK, MC_FWD,  KC_HOME, KC_END,
                   KC_DEL,  OS_LSFT, OS_LCTL, OS_LALT, OS_LGUI, MC_MUTE, KC_LEFT, KC_DOWN, KC_UP,
                   KC_RGHT, KC_BSPC, MC_BRDN, MC_BRUP, MC_PREV, MC_NEXT, MC_PLAY, KC_CAPS, KC_PGDN,
                   KC_PGUP, KC_INS,  KC_ENT,  KC_TRNS, KC_TRNS, KC_TRNS, MO_NUM,  KC_TRNS, KC_TRNS},

        /* Layer 3: Numeric
         *
         *   F10   F11   ___   ___   ___        ___   ___   ___   ___   ___
         *   7/S   5/C   3/A   1/G   9          8     0/G   2/A   4/C   6/S
         *   F7    F5    F3    F1    F9         F8    F12   F2    F4    F6
         *               ___   ___   ___        ___   ___   ___
         */
        [L_NUM] = {KC_F10,  KC_F11, KC_TRNS, KC_TRNS, KC_TRNS, KC_TRNS, KC_TRNS, KC_TRNS, KC_TRNS,
                   KC_TRNS, HM_7,   HM_5,    HM_3,    HM_1,    KC_9,    KC_8,    HM_0,    HM_2,
                   HM_4,    HM_6,   KC_F7,   KC_F5,   KC_F3,   KC_F1,   KC_F9,   KC_F8,   KC_F12,
                   KC_F2,   KC_F4,  KC_F6,   KC_TRNS, KC_TRNS, KC_TRNS, KC_TRNS, KC_TRNS, KC_TRNS},

        /* Layer 4: Gaming
         *
         *   Tab   Q     W     E     R          ___   ___   ___   ___   ___
         *   Esc   A     S     D     F          ___   ___   ___   ___   ___
         *   LSf   Z     X     C     V          ___   ___   ___   ___   ___
         *               LCt   G/NUM Spc        ___   ___   ___
         */
        [L_GAME] = {KC_TAB,  KC_Q,    KC_W,    KC_E,    KC_R,    KC_TRNS, KC_TRNS, KC_TRNS,
                    KC_TRNS, KC_TRNS, KC_ESC,  KC_A,    KC_S,    KC_D,    KC_F,    KC_TRNS,
                    KC_TRNS, KC_TRNS, KC_TRNS, KC_TRNS, KC_LSFT, KC_Z,    KC_X,    KC_C,
                    KC_V,    KC_TRNS, KC_TRNS, KC_TRNS, KC_TRNS, KC_TRNS, KC_LCTL, MO_GNUM,
                    KC_SPC,  KC_TRNS, KC_TRNS, KC_TRNS},

        /* Layer 5: Gaming Numbers  (hold LT2 from Gaming layer)
         *
         *   1     2     3     4     5          ___   ___   ___   ___   ___
         *   6     7     8     9     0          ___   ___   ___   ___   ___
         *   F1    F2    F3    F4    F5         ___   ___   ___   ___   ___
         *               ___   ___   ___        ___   ___   ___
         */
        [L_GAMENUM] = {KC_1,    KC_2,    KC_3,    KC_4,    KC_5,    KC_TRNS, KC_TRNS, KC_TRNS,
                       KC_TRNS, KC_TRNS, KC_6,    KC_7,    KC_8,    KC_9,    KC_0,    KC_TRNS,
                       KC_TRNS, KC_TRNS, KC_TRNS, KC_TRNS, KC_F1,   KC_F2,   KC_F3,   KC_F4,
                       KC_F5,   KC_TRNS, KC_TRNS, KC_TRNS, KC_TRNS, KC_TRNS, KC_TRNS, KC_TRNS,
                       KC_TRNS, KC_TRNS, KC_TRNS, KC_TRNS},

        /* Layer 6: Gaming Alt
         *
         *   1     2     W     3     4          6     ___   ___   ___   ___
         *   Q     A     S     D     E          T     B     V     Y     Esc
         *   Tab   5     ___   F     G          P     ___   ___   ___   ___
         *               Ctl   Sft   Spc        ___   ___   ___
         */
        [L_GAMEALT] = {KC_1,    KC_2,    KC_W,    KC_3,    KC_4,    KC_6,    KC_TRNS, KC_TRNS,
                       KC_TRNS, KC_TRNS, KC_Q,    KC_A,    KC_S,    KC_D,    KC_E,    KC_T,
                       KC_B,    KC_V,    KC_Y,    KC_ESC,  KC_TAB,  KC_5,    KC_TRNS, KC_F,
                       KC_G,    KC_P,    KC_TRNS, KC_TRNS, KC_TRNS, KC_TRNS, KC_LCTL, KC_LSFT,
                       KC_SPC,  KC_TRNS, KC_TRNS, KC_TRNS},

        /* Layer 7: Nomods
         *
         *   q     w     f     p     b          j     l     u     y     '
         *   a     r     s     t     g          m     n     e     i     o
         *   z     x     c     d     v          k     h     ,     .     ;
         *               Esc   NAV   Spc        Ent   SYM   Bks
         */
        [L_NOMOD] = {KC_Q,    KC_W,   KC_F,    KC_P,   KC_B,   KC_J,   KC_L,   KC_U,   KC_Y,
                     KC_QUOT, KC_A,   KC_R,    KC_S,   KC_T,   KC_G,   KC_M,   KC_N,   KC_E,
                     KC_I,    KC_O,   KC_Z,    KC_X,   KC_C,   KC_D,   KC_V,   KC_K,   KC_H,
                     KC_COMM, KC_DOT, KC_SCLN, KC_ESC, MO_NAV, KC_SPC, KC_ENT, MO_SYM, KC_BSPC},

        /* Layer 8: Origin (QWERTY)
         *
         *   q     w     e     r     t          y     u     i     o     p
         *   a     s     d     f     g          h     j     k     l     ;
         *   z     x     c     v     b          n     m     ,     .     /
         *               Esc   NAV   Spc        Ent   SYM   Bks
         */
        [L_ORIGIN] = {KC_Q,    KC_W,    KC_E,    KC_R,   KC_T,   KC_Y,   KC_U,   KC_I,   KC_O,
                      KC_P,    KC_A,    KC_S,    KC_D,   KC_F,   KC_G,   KC_H,   KC_J,   KC_K,
                      KC_L,    KC_SCLN, KC_Z,    KC_X,   KC_C,   KC_V,   KC_B,   KC_N,   KC_M,
                      KC_COMM, KC_DOT,  KC_SLSH, KC_ESC, MO_NAV, KC_SPC, KC_ENT, MO_SYM, KC_BSPC},
};

/* -------------------------------------------------------------------
 * Home row mod configuration
 *
 * Per-finger depth and time thresholds.  ADC estimates assume
 * ~147 counts/mm (500-count range over 3.4mm Owlab Ti HE travel).
 * Actual values calibrated during Stage 1, tuned during Stage 4.
 * ---------------------------------------------------------------- */

const struct keymap_hrm keymap_hrm_table[] = {
        /* Left hand: SCAG (Shift-Ctrl-Alt-GUI, pinky to index) */
        {POS_L06, 265, 250}, /* a -> LShift  (pinky, 1.8mm) */
        {POS_L07, 235, 220}, /* r -> LCtrl   (ring,  1.6mm) */
        {POS_L08, 206, 200}, /* s -> LAlt    (mid,   1.4mm) */
        {POS_L09, 176, 180}, /* t -> LGUI    (index, 1.2mm) */

        /* Right hand: mirrors left */
        {POS_R07, 176, 180}, /* n -> RGUI    (index, 1.2mm) */
        {POS_R08, 206, 200}, /* e -> RAlt    (mid,   1.4mm) */
        {POS_R09, 235, 220}, /* i -> RCtrl   (ring,  1.6mm) */
        {POS_R10, 265, 250}, /* o -> RShift  (pinky, 1.8mm) */
};

_Static_assert(KEYMAP_LEN(keymap_hrm_table) == KEYMAP_HRM_COUNT, "KEYMAP_HRM_COUNT");

/* -------------------------------------------------------------------
 * Bilateral key sets
 *
 * A modifier only fires when the opposite hand presses a key.
 * ---------------------------------------------------------------- */

const enum keymap_pos keymap_left_hand[] = {
        POS_L01, POS_L02, POS_L03, POS_L04, POS_L05, POS_L06, POS_L07, POS_L08, POS_L09,
        POS_L10, POS_L11, POS_L12, POS_L13, POS_L14, POS_L15, POS_LT1, POS_LT2, POS_LT3,
};

const enum keymap_pos keymap_right_hand[] = {
        POS_R01, POS_R02, POS_R03, POS_R04, POS_R05, POS_R06, POS_R07, POS_R08, POS_R09,
        POS_R10, POS_R11, POS_R12, POS_R13, POS_R14, POS_R15, POS_RT1, POS_RT2, POS_RT3,
};

_Static_assert(KEYMAP_LEN(keymap_left_hand) == KEYMAP_HAND_KEYS, "KEYMAP_HAND_KEYS");
_Static_assert(KEYMAP_LEN(keymap_right_hand) == KEYMAP_HAND_KEYS, "KEYMAP_HAND_KEYS");

/* -------------------------------------------------------------------
 * Combos
 *
 * Chord timeout: 50ms (adjustable).
 * ---------------------------------------------------------------- */

const struct keymap_combo keymap_combos[] = {

        /* -- Editing (vertical: top + home) -- */
        {{POS_L02, POS_L07, POS_NONE}, KC_ESC},  /* w+r  */
        {{POS_L03, POS_L08, POS_NONE}, KC_TAB},  /* f+s  */
        {{POS_R03, POS_R08, POS_NONE}, KC_DEL},  /* u+e  */
        {{POS_R04, POS_R09, POS_NONE}, CW_TOGG}, /* y+i  -> Caps Word */

        /* -- Brackets (vertical: home + bottom) -- */
        {{POS_L07, POS_L12, POS_NONE}, KC_LBRC}, /* r+x  -> [  */
        {{POS_L08, POS_L13, POS_NONE}, KC_LPRN}, /* s+c  -> (  */
        {{POS_L09, POS_L14, POS_NONE}, KC_LCBR}, /* t+d  -> {  */
        {{POS_R07, POS_R12, POS_NONE}, KC_RCBR}, /* n+h  -> }  */
        {{POS_R08, POS_R13, POS_NONE}, KC_RPRN}, /* e+,  -> )  */
        {{POS_R09, POS_R14, POS_NONE}, KC_RBRC}, /* i+.  -> ]  */

        /* -- Displaced keys (vertical) -- */
        {{POS_R02, POS_R07, POS_NONE}, KC_BSLS}, /* l+n  -> \  */
        {{POS_L01, POS_L06, POS_NONE}, KC_GRV},  /* q+a  -> `  */
        {{POS_R05, POS_R10, POS_NONE}, KC_TILD}, /* '+o  -> ~  */
        {{POS_L04, POS_L09, POS_NONE}, OS_HYPR}, /* p+t  -> Hyper */

        /* -- Programming shortcuts (horizontal) -- */
        {{POS_R13, POS_R14, POS_NONE}, KC_MINS}, /* ,+.  -> -  */
        {{POS_R14, POS_R15, POS_NONE}, KC_EQL},  /* .+;  -> =  */
        {{POS_R12, POS_R13, POS_NONE}, KC_UNDS}, /* h+,  -> _  */
        {{POS_L12, POS_L13, POS_NONE}, KC_CAPS}, /* x+c  -> Caps Lock */

        /* -- Layer toggles -- */
        {{POS_LT1, POS_LT2, POS_LT3, POS_NONE}, KM_TG(L_GAME)},    /* all L thumbs -> Gaming  */
        {{POS_RT1, POS_RT2, POS_RT3, POS_NONE}, KM_TG(L_GAMEALT)}, /* all R thumbs -> Game Alt */
        {{POS_LT1, POS_RT3, POS_NONE}, KM_TG(L_NOMOD)},            /* outer thumbs -> Nomods  */
        {{POS_LT1, POS_LT2, POS_RT2, POS_RT3, POS_NONE}, KM_TG(L_ORIGIN)}, /* 4 thumbs -> Origin */
};

_Static_assert(KEYMAP_LEN(keymap_combos) == KEYMAP_COMBOS, "KEYMAP_COMBOS");

/* -------------------------------------------------------------------
 * SOCD pairs  (gaming layer only)
 *
 * Resolution: last-input-wins.
 * ---------------------------------------------------------------- */

const struct keymap_socd_pair keymap_socd_pairs[] = {
        {POS_L03, POS_L08}, /* W / S  (vertical)   */
        {POS_L07, POS_L09}, /* A / D  (horizontal) */
};

_Static_assert(KEYMAP_LEN(keymap_socd_pairs) == KEYMAP_SOCD_PAIRS, "KEYMAP_SOCD_PAIRS");
```

## src/rapid_trigger.c
```c
/*
 * Rapid Trigger FSM implementation.
 *
 * Higher ADC values mean a deeper key press.  The FSM tracks peak
 * (deepest) and trough (shallowest) positions and fires events when
 * the direction reverses by more than the configured sensitivity.
 */

#include "rapid_trigger.h"

/* --------------------------------------------------------------------- */

void rt_init(struct rt_key_state *key, const struct rt_config *cfg)
{
    key->state = RT_IDLE;
    key->peak = cfg->rest_adc;
    key->trough = cfg->rest_adc;
    key->cfg = *cfg;
}

/* --------------------------------------------------------------------- */

static enum rt_event handle_idle(struct rt_key_state *key, uint16_t adc)
{
    if (adc >= key->cfg.actuation_adc) {
        key->state = RT_ACTIVE;
        key->peak = adc;
        key->trough = adc;
        return RT_EVENT_PRESS;
    }
    return RT_EVENT_NONE;
}

static enum rt_event handle_active(struct rt_key_state *key, uint16_t adc)
{
    if (adc >= key->peak) {
        key->peak = adc;
        return RT_EVENT_NONE;
    }

    if (adc <= key->cfg.release_adc) {
        key->state = RT_IDLE;
        key->peak = key->cfg.rest_adc;
        key->trough = key->cfg.rest_adc;
        return RT_EVENT_RELEASE;
    }

    if (key->peak - adc >= key->cfg.rt_sensitivity) {
        key->state = RT_RELEASING;
        key->trough = adc;
        return RT_EVENT_RELEASE;
    }

    return RT_EVENT_NONE;
}

static enum rt_event handle_releasing(struct rt_key_state *key, uint16_t adc)
{
    if (adc <= key->trough) {
        key->trough = adc;

        if (adc <= key->cfg.release_adc) {
            key->state = RT_IDLE;
            key->peak = key->cfg.rest_adc;
            key->trough = key->cfg.rest_adc;
            return RT_EVENT_NONE;
        }
        return RT_EVENT_NONE;
    }

    if (adc - key->trough >= key->cfg.rt_sensitivity) {
        key->state = RT_ACTIVE;
        key->peak = adc;
        return RT_EVENT_PRESS;
    }

    return RT_EVENT_NONE;
}

/* --------------------------------------------------------------------- */

enum rt_event rt_update(struct rt_key_state *key, uint16_t adc)
{
    switch (key->state) {
    case RT_IDLE:
        return handle_idle(key, adc);
    case RT_ACTIVE:
        return handle_active(key, adc);
    case RT_RELEASING:
        return handle_releasing(key, adc);
    }

    return RT_EVENT_NONE;
}
```

## src/rapid_trigger.h
```c
/*
 * Rapid Trigger -- per-key actuation via direction reversal.
 *
 * Pure C module, no RTOS dependencies.  ADC values are expected to
 * increase as the key is pressed deeper (higher value = deeper press).
 *
 * State machine:
 *   IDLE  ──press past actuation──▸  ACTIVE
 *   ACTIVE ──reversal up past sensitivity──▸  RELEASING
 *   RELEASING ──reversal down past sensitivity──▸  ACTIVE
 *   ACTIVE / RELEASING ──passes release point──▸  IDLE
 */

#ifndef RAPID_TRIGGER_H
#define RAPID_TRIGGER_H

#include <stdbool.h>
#include <stdint.h>

/* ---------------------------------------------------------------------
 * Types
 * ------------------------------------------------------------------ */

enum rt_state {
    RT_IDLE,
    RT_ACTIVE,
    RT_RELEASING,
};

enum rt_event {
    RT_EVENT_NONE,
    RT_EVENT_PRESS,
    RT_EVENT_RELEASE,
};

/**
 * Per-key configuration.  All values are in raw ADC counts.
 *
 * @rest_adc        ADC reading when the key is fully released (at rest).
 * @actuation_adc   ADC value that triggers the initial press from IDLE.
 * @release_adc     ADC value below which the key is considered fully
 *                  released, returning the FSM to IDLE.
 * @rt_sensitivity  Minimum change (in counts) from peak/trough required
 *                  to register a direction reversal.
 */
struct rt_config {
    uint16_t rest_adc;
    uint16_t actuation_adc;
    uint16_t release_adc;
    uint16_t rt_sensitivity;
};

/**
 * Per-key runtime state.  Initialise with rt_init() before first use.
 */
struct rt_key_state {
    enum rt_state state;
    uint16_t peak;   /* deepest ADC seen since last upward reversal  */
    uint16_t trough; /* shallowest ADC seen since last downward rev  */
    struct rt_config cfg;
};

/* ---------------------------------------------------------------------
 * API
 * ------------------------------------------------------------------ */

/**
 * Initialise (or reinitialise) a key's rapid-trigger state.
 */
void rt_init(struct rt_key_state *key, const struct rt_config *cfg);

/**
 * Feed a new ADC sample and return the resulting key event.
 *
 * Call once per scan cycle per key.  The function is pure -- it has no
 * side-effects beyond mutating *key and returns a deterministic result.
 */
enum rt_event rt_update(struct rt_key_state *key, uint16_t adc);

/* ---------------------------------------------------------------------
 * Helpers
 * ------------------------------------------------------------------ */

/**
 * Convert millimetres of travel to ADC counts.
 *
 * @counts_per_mm  Calibrated ratio (e.g. usable_range / travel_mm).
 */
static inline uint16_t rt_mm_to_counts(float mm, float counts_per_mm)
{
    return (uint16_t)(mm * counts_per_mm + 0.5f);
}

/**
 * Convert ADC counts to millimetres of travel.
 */
static inline float rt_counts_to_mm(uint16_t counts, float counts_per_mm)
{
    return (float)counts / counts_per_mm;
}

#endif /* RAPID_TRIGGER_H */
```

## src/socd.c
```c
/*
 * SOCD cleaning implementation -- last-input-wins.
 */

#include "socd.h"

/* --------------------------------------------------------------------- */

void socd_init(struct socd_pair *pair)
{
    pair->a_active = false;
    pair->b_active = false;
    pair->last_pressed = SOCD_LAST_NONE;
}

void socd_press_a(struct socd_pair *pair)
{
    pair->a_active = true;
    pair->last_pressed = SOCD_LAST_A;
}

void socd_release_a(struct socd_pair *pair)
{
    pair->a_active = false;
    if (pair->last_pressed == SOCD_LAST_A) {
        pair->last_pressed = pair->b_active ? SOCD_LAST_B : SOCD_LAST_NONE;
    }
}

void socd_press_b(struct socd_pair *pair)
{
    pair->b_active = true;
    pair->last_pressed = SOCD_LAST_B;
}

void socd_release_b(struct socd_pair *pair)
{
    pair->b_active = false;
    if (pair->last_pressed == SOCD_LAST_B) {
        pair->last_pressed = pair->a_active ? SOCD_LAST_A : SOCD_LAST_NONE;
    }
}

struct socd_result socd_resolve(const struct socd_pair *pair)
{
    struct socd_result r = {false, false};

    if (pair->a_active && pair->b_active) {
        /* Both active -- last input wins. */
        if (pair->last_pressed == SOCD_LAST_A) {
            r.a_output = true;
        } else {
            r.b_output = true;
        }
    } else {
        r.a_output = pair->a_active;
        r.b_output = pair->b_active;
    }

    return r;
}
```
